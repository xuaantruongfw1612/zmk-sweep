/*
 * Copyright (c) 2020 The ZMK Contributors
 *
 * SPDX-License-Identifier: MIT
 */

#include "ferris_sweep.dtsi"

&kscan0 {
    compatible = "zmk,kscan-gpio-direct";
    wakeup-source;
    
    input-gpios
        = <&gpio0  9 (GPIO_ACTIVE_LOW | GPIO_PULL_UP)>
        , <&gpio1  6 (GPIO_ACTIVE_LOW | GPIO_PULL_UP)>
        , <&gpio1  4 (GPIO_ACTIVE_LOW | GPIO_PULL_UP)>
        , <&gpio0 11 (GPIO_ACTIVE_LOW | GPIO_PULL_UP)>
        , <&gpio1  0 (GPIO_ACTIVE_LOW | GPIO_PULL_UP)>
        , <&gpio1 15 (GPIO_ACTIVE_LOW | GPIO_PULL_UP)>
        , <&gpio1 13 (GPIO_ACTIVE_LOW | GPIO_PULL_UP)>
        , <&gpio1 11 (GPIO_ACTIVE_LOW | GPIO_PULL_UP)>
        ;
};

