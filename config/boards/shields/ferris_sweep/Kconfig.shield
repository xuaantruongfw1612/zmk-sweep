## config/boards/shields/ferris_sweep/Kconfig.shield
```kconfig
# Copyright (c) 2020 The ZMK Contributors
# SPDX-License-Identifier: MIT

config SHIELD_FERRIS_SWEEP_LEFT
    def_bool $(shields_list_contains,ferris_sweep_left)

config SHIELD_FERRIS_SWEEP_RIGHT
    def_bool $(shields_list_contains,ferris_sweep_right)
```
